## config/boards/shields/chocoball50/Kconfig
```kconfig
# Copyright (c) 2024 The ZMK Contributors
# SPDX-License-Identifier: MIT

config SHIELD_CHOCOBALL50
    def_bool $(shields_list_contains,chocoball50)
```

## config/boards/shields/chocoball50/Kconfig.defconfig
```kconfig
if SHIELD_CHOCOBALL50

config ZMK_KEYBOARD_NAME
    default "Chocoball50"

config ZMK_USB_LOGGING
    default n

# SPI for LED strip
config SPI
    default y

# LED strip configuration
config LED_STRIP
    default y

config ZMK_RGB_UNDERGLOW
    default y

config ZMK_RGB_UNDERGLOW_EXT_POWER
    default y

config ZMK_RGB_UNDERGLOW_AUTO_OFF_IDLE
    default y

# Encoder configuration
# Re-enabled with duplex matrix
config EC11
    default y

# Trackball (az1uball) configuration
config I2C
    default y

config INPUT
    default y

config ZMK_MOUSE
    default y

# az1uball driver configuration (integrated)
if I2C && INPUT

config AZ1UBALL
    bool "az1uball trackball driver"
    default y
    help
      Enable driver for az1uball trackball module.
      The az1uball uses hall effect sensors and communicates
      via I2C at address 0x0A.

config AZ1UBALL_THREAD_PRIORITY
    int "az1uball thread priority"
    default 50
    depends on AZ1UBALL
    help
      Priority of thread used to handle the trackball data.

config AZ1UBALL_POLL_INTERVAL_MS
    int "az1uball polling interval in milliseconds"
    default 8
    depends on AZ1UBALL
    help
      Interval between polling the az1uball for movement data.

endif

endif
```

## config/boards/shields/chocoball50/az1uball/Kconfig
```kconfig
# Copyright (c) 2025 The ZMK Contributors
# SPDX-License-Identifier: MIT

config AZ1UBALL
	bool "az1uball trackball driver"
	default n
	depends on I2C && INPUT
	help
	  Enable driver for az1uball trackball module.
	  The az1uball uses hall effect sensors and communicates
	  via I2C at address 0x0A.

if AZ1UBALL

config AZ1UBALL_THREAD_PRIORITY
	int "Thread priority"
	default 10
	help
	  Priority of thread used to handle the trackball data.

config AZ1UBALL_POLL_INTERVAL_MS
	int "Polling interval in milliseconds"
	default 8
	help
	  Interval between polling the az1uball for movement data.

endif # AZ1UBALL
```

## config/boards/shields/chocoball50/drivers/kscan/Kconfig
```kconfig
# Copyright (c) 2024 The ZMK Contributors
# SPDX-License-Identifier: MIT

config ZMK_KSCAN_GPIO_DUPLEX
    bool "Japanese duplex matrix keyboard scan driver"
    depends on GPIO
    select KSCAN
    help
      Enable support for Japanese duplex matrix scanning.

      This driver allows bidirectional scanning of a keyboard matrix,
      where the same GPIO pins alternate between column (output) and
      row (input) roles in two separate scanning passes.

      This significantly reduces the number of GPIO pins needed:
      - Standard 4x13 matrix: 17 pins
      - Duplex 7+4 matrix: 11 pins (52+ keys capacity)

      Requires proper diode placement for bidirectional scanning.
```

## config/boards/shields/chocoball50/dts/bindings/zmk,kscan-gpio-duplex.yaml
```yaml
# Copyright (c) 2024 The ZMK Contributors
# SPDX-License-Identifier: MIT

description: |
  Japanese duplex matrix keyboard scan driver for ZMK.

  This driver implements bidirectional matrix scanning where the same set of
  GPIO pins is used for both rows and columns by alternating their roles:

  Pass 1: Pins [0..duplex-gpios) are columns (output),
          Pins [duplex-gpios..end) are rows (input)
  Pass 2: Pins [0..duplex-gpios) are rows (input),
          Pins [duplex-gpios..end) are columns (output)

  This allows scanning approximately 2*N*M keys with N+M GPIO pins instead
  of requiring N+M pins for an N*M matrix.

  Example for 52 keys:
    - Standard matrix: 4 rows + 13 cols = 17 pins
    - Duplex matrix: 7 cols + 4 rows = 11 pins (6 pins saved)

  Hardware requirements:
    - Diodes in series with each switch
    - Proper orientation for each pass scanning direction

compatible: "zmk,kscan-gpio-duplex"

properties:
  gpios:
    type: phandle-array
    required: true
    description: |
      Array of GPIOs used for the duplex matrix.
      First N pins (0 to duplex-gpios-1) act as columns in pass 1, rows in pass 2.
      Remaining pins (duplex-gpios to end) act as rows in pass 1, columns in pass 2.

  duplex-gpios:
    type: int
    required: true
    description: |
      Index that splits the GPIO array into two groups for duplex scanning.
      Pins [0..duplex-gpios) are driven in pass 1, sensed in pass 2.
      Pins [duplex-gpios..length) are sensed in pass 1, driven in pass 2.

      Example: For 11 pins with duplex-gpios = 7:
        Pass 1: 7 columns × 4 rows = 28 keys
        Pass 2: 7 rows × 4 columns = 28 keys
        Total: 56 key capacity

  debounce-period-ms:
    type: int
    default: 5
    description: |
      Debounce period in milliseconds.
      Used as scan interval when keys are being pressed/released.

  poll-period-ms:
    type: int
    default: 10
    description: |
      Polling period in milliseconds when no keys are pressed.
      Scan interval increases to this value when matrix is idle.
```

## config/drivers/Kconfig
```kconfig
# Copyright (c) 2025 The ZMK Contributors
# SPDX-License-Identifier: MIT

rsource "input/az1uball/Kconfig"
```

## config/dts/bindings/input/palette,az1uball.yaml
```yaml
# Copyright (c) 2025 The ZMK Contributors
# SPDX-License-Identifier: MIT

description: |
  az1uball trackball module by Palette System.
  Uses hall effect sensors and communicates via I2C.

compatible: "palette,az1uball"

include: i2c-device.yaml

properties:
  invert-x:
    type: boolean
    description: Invert X-axis movement

  invert-y:
    type: boolean
    description: Invert Y-axis movement

  swap-xy:
    type: boolean
    description: Swap X and Y axes
```
